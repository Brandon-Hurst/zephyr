## boards/nordic/nrf7002dk/nrf7002dk_nrf5340_cpunet_defconfig
```kconfig
# SPDX-License-Identifier: Apache-2.0

# Enable MPU
CONFIG_ARM_MPU=y

# Enable GPIO
CONFIG_GPIO=y

# Enable UART driver
CONFIG_SERIAL=n

# Enable console
CONFIG_CONSOLE=n
CONFIG_UART_CONSOLE=n
```
